## sdkconfig.defaults
```kconfig
# Parking Garage Control System - Default Configuration

# Compiler options
CONFIG_COMPILER_CXX_EXCEPTIONS=n
CONFIG_COMPILER_CXX_RTTI=n

# FreeRTOS
CONFIG_FREERTOS_HZ=1000
CONFIG_FREERTOS_USE_TRACE_FACILITY=y
CONFIG_FREERTOS_USE_STATS_FORMATTING_FUNCTIONS=y
CONFIG_FREERTOS_TIMER_TASK_STACK_DEPTH=6144

# Logging
CONFIG_LOG_DEFAULT_LEVEL_INFO=y
CONFIG_LOG_MAXIMUM_LEVEL_VERBOSE=y

# Console
CONFIG_ESP_CONSOLE_UART_DEFAULT=y
CONFIG_ESP_CONSOLE_UART_NUM=0
CONFIG_ESP_CONSOLE_UART_BAUDRATE=115200

# Parking system - Test mode by default
CONFIG_PARKING_CAPACITY_TEST=y
CONFIG_PARKING_CAPACITY=5

# GPIO defaults (Note: GPIO34-39 are input-only, no internal pull-ups!)
CONFIG_PARKING_ENTRY_BUTTON_GPIO=25
CONFIG_PARKING_ENTRY_LIGHT_BARRIER_GPIO=23
CONFIG_PARKING_ENTRY_MOTOR_GPIO=22
CONFIG_PARKING_EXIT_LIGHT_BARRIER_GPIO=15
CONFIG_PARKING_EXIT_MOTOR_GPIO=2

# System parameters
CONFIG_PARKING_BARRIER_TIMEOUT_MS=2000
CONFIG_PARKING_BUTTON_DEBOUNCE_MS=50

# Console
CONFIG_PARKING_CONSOLE_ENABLED=y
CONFIG_PARKING_CONSOLE_MAX_ARGS=8
```

## test/unity-hw-tests/main/Kconfig.projbuild
```kconfig
menu "Parking Garage Control System Configuration"

    menu "GPIO Configuration"

        config PARKING_ENTRY_BUTTON_GPIO
            int "Entry Button GPIO"
            default 25
            range 0 33
            help
                GPIO pin for entry button (with internal pull-up).
                Note: GPIO34-39 are input-only and do not support internal pull-ups!

        config PARKING_ENTRY_LIGHT_BARRIER_GPIO
            int "Entry Light Barrier GPIO"
            default 15
            range 0 39
            help
                GPIO pin for entry light barrier sensor (with internal pull-up).

        config PARKING_ENTRY_MOTOR_GPIO
            int "Entry Barrier Motor GPIO"
            default 22
            range 0 39
            help
                GPIO pin for entry barrier motor control.

        config PARKING_EXIT_LIGHT_BARRIER_GPIO
            int "Exit Light Barrier GPIO"
            default 23
            range 0 39
            help
                GPIO pin for exit light barrier sensor (with internal pull-up).

        config PARKING_EXIT_MOTOR_GPIO
            int "Exit Barrier Motor GPIO"
            default 2
            range 0 33
            help
                GPIO pin for exit barrier motor control.

    endmenu

    menu "System Configuration"

        choice PARKING_CAPACITY_MODE
            prompt "Parking Capacity Mode"
            default PARKING_CAPACITY_TEST
            help
                Select parking capacity configuration.

            config PARKING_CAPACITY_TEST
                bool "Test Mode (5 spaces)"
                help
                    Use reduced capacity for testing (5 parking spaces).

            config PARKING_CAPACITY_PRODUCTION
                bool "Production Mode (2000 spaces)"
                help
                    Use full production capacity (2000 parking spaces).

            config PARKING_CAPACITY_CUSTOM
                bool "Custom Capacity"
                help
                    Specify custom parking capacity.

        endchoice

        config PARKING_CAPACITY
            int "Parking Capacity" if PARKING_CAPACITY_CUSTOM
            default 5 if PARKING_CAPACITY_TEST
            default 2000 if PARKING_CAPACITY_PRODUCTION
            range 1 10000
            help
                Maximum number of parking spaces.

        config PARKING_BARRIER_TIMEOUT_MS
            int "Barrier Timeout (milliseconds)"
            default 2000
            range 500 10000
            help
                Time for barrier to open/close completely.

        config PARKING_BUTTON_DEBOUNCE_MS
            int "Button Debounce Time (milliseconds)"
            default 50
            range 0 500
            help
                Debounce time for entry button (0 = no debouncing).

    endmenu

    menu "Console Configuration"

        config PARKING_CONSOLE_ENABLED
            bool "Enable Console Commands"
            default y
            help
                Enable ESP console commands for system control and monitoring.

        config PARKING_CONSOLE_MAX_ARGS
            int "Maximum Console Arguments"
            default 8
            range 1 16
            depends on PARKING_CONSOLE_ENABLED
            help
                Maximum number of arguments for console commands.

    endmenu

endmenu
```

## test/unity-hw-tests/sdkconfig.defaults
```kconfig
# Unity Hardware Tests Configuration

# Logging
CONFIG_LOG_DEFAULT_LEVEL_INFO=y
CONFIG_LOG_MAXIMUM_LEVEL_VERBOSE=y

# Serial monitor
CONFIG_ESP_CONSOLE_UART_DEFAULT=y

# Unity test runner (ESP-IDF)
CONFIG_UNITY_ENABLE=y
CONFIG_UNITY_ENABLE_IDF_TEST_RUNNER=y
CONFIG_UNITY_ENABLE_FLOAT=y
CONFIG_UNITY_ENABLE_DOUBLE=y
CONFIG_UNITY_ENABLE_BACKTRACE_ON_FAIL=y

# Disable watchdogs for tests
CONFIG_ESP_INT_WDT=n
CONFIG_ESP_TASK_WDT=n
CONFIG_ESPTOOLPY_FLASHSIZE_4MB=y

# Run-time checks of Heap and Stack
CONFIG_HEAP_POISONING_COMPREHENSIVE=y
CONFIG_COMPILER_STACK_CHECK_MODE_STRONG=y
CONFIG_COMPILER_STACK_CHECK=y
CONFIG_ESP_MAIN_TASK_STACK_SIZE=16000

# Compiler options
CONFIG_COMPILER_CXX_EXCEPTIONS=n
CONFIG_COMPILER_CXX_RTTI=n

# FreeRTOS
CONFIG_FREERTOS_HZ=1000
CONFIG_FREERTOS_USE_TRACE_FACILITY=y
CONFIG_FREERTOS_USE_STATS_FORMATTING_FUNCTIONS=y
CONFIG_FREERTOS_TIMER_TASK_STACK_DEPTH=6144

# Console
CONFIG_ESP_CONSOLE_UART_DEFAULT=y
CONFIG_ESP_CONSOLE_UART_NUM=0
CONFIG_ESP_CONSOLE_UART_BAUDRATE=115200

# Parking system - Fast test settings
CONFIG_PARKING_CAPACITY_TEST=y
CONFIG_PARKING_CAPACITY=2
CONFIG_PARKING_BARRIER_TIMEOUT_MS=500
CONFIG_PARKING_BUTTON_DEBOUNCE_MS=50

# GPIO defaults
CONFIG_PARKING_ENTRY_BUTTON_GPIO=25
CONFIG_PARKING_ENTRY_LIGHT_BARRIER_GPIO=23
CONFIG_PARKING_ENTRY_MOTOR_GPIO=22
CONFIG_PARKING_EXIT_LIGHT_BARRIER_GPIO=4
CONFIG_PARKING_EXIT_MOTOR_GPIO=2

# Console
CONFIG_PARKING_CONSOLE_ENABLED=y
CONFIG_PARKING_CONSOLE_MAX_ARGS=8
```
